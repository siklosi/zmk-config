## boards/shields/g25_box/Kconfig.defconfig
```kconfig
# Copyright (c) 2026
# SPDX-License-Identifier: MIT

if SHIELD_G25_BOX

config ZMK_KEYBOARD_NAME
    default "G25 Box (8B-3E)"

endif
```

## boards/shields/g25_box/Kconfig.shield
```kconfig
# Copyright (c) 2026
# SPDX-License-Identifier: MIT

config SHIELD_G25_BOX
    def_bool $(shields_list_contains,g25_box)
```
