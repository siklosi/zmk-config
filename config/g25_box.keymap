/*
 * Copyright (c) 2026
 * SPDX-License-Identifier: MIT
 */

#include <behaviors.dtsi>
#include <dt-bindings/zmk/keys.h>

/ {
    keymap {
        compatible = "zmk,keymap";

        race_layer {
            bindings = <
                &kp F13 &kp F14 &kp F15 &kp F16 &kp F17 &kp F18 &kp F19 &lt 1 F20
            >;

            sensor-bindings = <
                &inc_dec_kp F21 F22
                &inc_dec_kp F23 F24
                &inc_dec_kp F1 F2
            >;
        };

        system_layer {
            bindings = <
                &kp F3 &kp F4 &kp F5 &kp F6 &kp F7 &kp C_MUTE &kp F8 &kp F9
            >;

            sensor-bindings = <
                &inc_dec_kp C_VOL_UP C_VOL_DN
                &inc_dec_kp F10 F11
                &inc_dec_kp F12 PG_UP
            >;
        };
    };
};
